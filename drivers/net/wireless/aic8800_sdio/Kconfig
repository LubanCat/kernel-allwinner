## drivers/net/wireless/aic8800_sdio/Kconfig
```kconfig
config AIC_WLAN_SDIO_SUPPORT
	bool "AIC sdio wireless Support"
	default n
	help
	  This is support for aic sdio wireless chip.

if AIC_WLAN_SDIO_SUPPORT
source "drivers/net/wireless/aic8800_sdio/aic8800_fdrv/Kconfig"
source "drivers/net/wireless/aic8800_sdio/aic8800_btlpm/Kconfig"
endif
```
