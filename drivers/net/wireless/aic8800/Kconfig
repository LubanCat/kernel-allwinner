## drivers/net/wireless/aic8800/Kconfig
```kconfig
config AIC_WLAN_SUPPORT_SDIO
	bool "AIC SDIO wireless Support"
	default n
	help
	  This is support for aic wireless chip.

if AIC_WLAN_SUPPORT_SDIO
source "drivers/net/wireless/aic8800/aic8800_fdrv/Kconfig"
source "drivers/net/wireless/aic8800/aic8800_btlpm/Kconfig"
endif
```

## drivers/net/wireless/aic8800_usb/Kconfig
```kconfig
config AIC_WLAN_SUPPORT_USB
	bool "AIC USB wireless Support"
	default n
	help
	  This is support for aic wireless chip.

if AIC_WLAN_SUPPORT_USB
source "drivers/net/wireless/aic8800_usb/aic8800_fdrv/Kconfig"
source "drivers/net/wireless/aic8800_usb/aic_load_fw/Kconfig"
endif
```
